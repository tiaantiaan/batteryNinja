#include "EspMQTTClient.h"
#include <Adafruit_GFX.h>
#include <Adafruit_SSD1306.h>
#include <DallasTemperature.h>
#include <NoDelay.h>
#include <OneWire.h>

// OLED Configuration
#define SCREEN_WIDTH  128 // OLED display width, in pixels
#define SCREEN_HEIGHT 64 // OLED display height, in pixels
#define OLED_RESET     -1 // Reset pin # (or -1 if sharing Arduino reset pin)
Adafruit_SSD1306 display(SCREEN_WIDTH, SCREEN_HEIGHT, &Wire, OLED_RESET);

// MQTT Client Configuration
EspMQTTClient mqttClient(
  "MYWIFIACCESSPOINT",  // Wifi Accesspoint
  "PASSWORD",           // Wifi password
  "192.168.8.200",      // MQTT Broker server ip
  "MQTTUsername",       // Can be omitted if not needed
  "",                   // Can be omitted if not needed
  "batteryninja"        // Client name that uniquely identify your device
);

// Configure update interval
#define UPDATE_INTERVAL_MS 30000     // Read the battery voltage every x milliseconds
#define ICON_FLASH_INTERVAL_MS 1000  // Flash the status icon every x milliseconds

// ADC Setup
const int analogInPin = A0;     // ESP8266 Analog Pin ADC0 = A0

// Temperature sensor (Texas Instruments ds18b20) configuration
#define ONE_WIRE_BUS D4     // Temperature sensor pin
OneWire oneWire(ONE_WIRE_BUS); 
DallasTemperature sensors(&oneWire);
float temperature = 0; 
float previousTemperature = 0;

// Battery configuration
const int numberOfBatteries = 2; // Number of 12V batteries in series
const float minBatteryVoltage = 10.8*numberOfBatteries;
const float maxBatteryVoltage = 13.8*numberOfBatteries; // This is the maximum charged voltage. From https://www.vision-batt.com/site/product_files/6FM100-X.pdf this value actually varies with temperature. When charging the voltage goes up to 15V.
const float chargingVoltage = 14*numberOfBatteries; // Voltage that charger charger batteries at.
bool isCharging = false;
float sensorValue = 0;          // value read from the pot
float batteryVoltage = 0;
float previousBatteryVoltage = 0;
float batteryPercentage = 0;

// Non blocking delays configuration (https://github.com/M-tech-Creations/NoDelay)
noDelay updateInterval(30000);
noDelay flickerInterval(1000);

// Graphs setup
const int graphLength = 86;
float batteryVoltageGraph[graphLength];
float temperatureGraph[graphLength];
bool flickerOn = false;
int state = 3;
  
void setup()
{
  Serial.begin(115200);

  // OLED display setup
  if (!display.begin(SSD1306_SWITCHCAPVCC, 0x3C)) { // Address 0x3C for 128x32
    Serial.println(F("SSD1306 allocation failed"));
    for(;;); // Don't proceed, loop forever
  }
  // Temperature sensor setup
  sensors.begin();

  // Display logo for 5 seconds
  displayLogo();
  delay(5000);

  // Optional parameters of EspMQTTClient (https://github.com/plapointe6/EspMQTTClient)
  mqttClient.enableDebuggingMessages(); // Enable debugging messages sent to serial output
}

// This function is called once everything is connected (Wifi and MQTT)
// Note: You must implement it if you use EspMQTTClient
void onConnectionEstablished() {
}

bool firstrun = true;

void loop()
{
  mqttClient.loop();

  // Flicker charging icon
  if (flickerInterval.update()) {
    if (flickerOn) {  
      display.setTextColor(SSD1306_WHITE);  
    } else {
      display.setTextColor(SSD1306_BLACK);
    }
    display.setCursor(0, 0);
    if (state == 1) {
      display.print((char)0x18);
      display.setTextColor(SSD1306_WHITE);
      display.print((" Charging "));
    } else if (state == 2) {
      display.print((char)0x19);
      display.setTextColor(SSD1306_WHITE);
      display.print((" Discharging "));
    } else {
      display.print((char)0xEF);
      display.setTextColor(SSD1306_WHITE);
      display.print((" Charged "));
    }
    flickerOn = !flickerOn;
    display.display();
  }

  // Only read sensors every update interval
  if (firstrun || updateInterval.update()) {
    firstrun = false;
    //Read temperature
    sensors.requestTemperatures(); 
    temperature = sensors.getTempCByIndex(0);

    // Read the analog input value
    sensorValue = analogRead(analogInPin); // For a NodeMCU, the maximum sensorValue is 1024 for an input voltage of 3.3V
    batteryVoltage = (sensorValue * 33)/1024; // Given a 9 to 1 voltage divider
    batteryPercentage = (batteryVoltage - minBatteryVoltage)/(maxBatteryVoltage - minBatteryVoltage)*100;
    if (batteryPercentage > 100) {
      batteryPercentage = 100;
    }
    isCharging = batteryVoltage > chargingVoltage;

    // Print values in the Serial Monitor
    Serial.print("Temperature: ");
    Serial.println(temperature);

    Serial.print("ADC value: ");
    Serial.println(sensorValue);

    Serial.print("Battery Voltage: ");
    Serial.println(batteryVoltage);

    Serial.print("Battery Percentage: ");
    Serial.println(batteryPercentage);

    // Only publish MQTT messages if the value changed from the previous value
    if (previousBatteryVoltage != batteryVoltage) {
      previousBatteryVoltage = batteryVoltage;
      mqttClient.publish("tele/batteryninja/BATTERY", "{\"voltage\":" + String(batteryVoltage) + ", \"battery_percentage\":" + String(batteryPercentage) + "}");
    }
    if (previousTemperature != temperature) {
      previousTemperature = temperature;
      mqttClient.publish("tele/batteryninja/TEMPERATURE", "{\"temperature\":" + String(temperature) + "}");
    }

    // Add the latest value the graph data
    updateGraphValues(batteryVoltage, batteryVoltageGraph);

    // Update the temp and battery values on the display
    updateDisplay(temperature, batteryVoltage, batteryPercentage);
  }
}

void updateGraphValues(float latestValue, float theArray[]) {
  for ( int k = 0 ; k < graphLength-1 ; k++ ) {
    theArray[k] = theArray[k+1];
  }
  theArray[graphLength - 1] = latestValue;
}

void updateDisplay(float temperature, float voltage, float percentage) {
  display.clearDisplay();
  display.setTextColor(SSD1306_WHITE);
  display.setTextSize(1);

  // Determine state (charging, discharging or charged)
  // Note: This is not very robust when the measured voltage varies a lot between readings, so it needs a rethink.
  if (isCharging) {
    state = 1; // Charging
  } else if (batteryVoltageGraph[graphLength-1] - batteryVoltageGraph[graphLength-2] < 1) {
   state = 2; // If the previous value was larger than the present value, set state to "discharging"
  } else {
    state = 3; // Charged
  }

  // Display values on screen
  display.setCursor(0, 15);
  display.println(("P: " + String(voltage) + "V"));

  display.setCursor(0, 25);
  display.println(("T: " + String(temperature) + (char)0xF7 + "C"));

  // Battery picture
  display.drawRect(89+9, 0, 19, 6, SSD1306_WHITE); // Battery terminal
  display.drawRect(89, 5, 38, 59, SSD1306_WHITE); // Battery big block

  int blockHeight = int(percentage/100*56);
  display.fillRect(89+2, 5+2+(56-blockHeight), 38-4, blockHeight-1, SSD1306_WHITE); // Battery fill

  // Graph
  float maximumGraphValue = 0;
  float minimumGraphValue = 99999;
  for ( int k = 0 ; k < graphLength ; k++ ) {
    if (batteryVoltageGraph[k] > maximumGraphValue) {
      maximumGraphValue = batteryVoltageGraph[k]; 
    }
    if (batteryVoltageGraph[k] > 0 && batteryVoltageGraph[k] < minimumGraphValue) { // Ignore the 0's in the empty array
      minimumGraphValue = batteryVoltageGraph[k]; 
    }
  } 

  if (maximumGraphValue - minimumGraphValue < 2) {
    minimumGraphValue = minimumGraphValue - 3; // Make the graph not show up as random dots when the max and min are very close together
  }

  // Debug messages
  Serial.print("MinimumGraphValue: ");
  Serial.println(minimumGraphValue);

  Serial.print("MaximumGraphValue: ");
  Serial.println(maximumGraphValue);

  const int maxGraphHeight = 23;

  // Graph axis
  display.drawLine(0,63,0,63-maxGraphHeight,SSD1306_WHITE);
  display.drawLine(0,63,87,63,SSD1306_WHITE);

  // Draw graph as lines between data points
  for ( int k = 0 ; k < graphLength - 1 ; k++ ) {
    display.drawLine(k+1, 64-int(((batteryVoltageGraph[k]-minimumGraphValue)/(maximumGraphValue-minimumGraphValue))*maxGraphHeight)+1, k+2 ,  64-int(((batteryVoltageGraph[k+1]-minimumGraphValue)/(maximumGraphValue-minimumGraphValue))*maxGraphHeight)+1, SSD1306_WHITE); // draw pixel
  }

  // Draw last pixed not drawn in previous step
  int k = graphLength - 1;
  display.drawPixel(k+1, 64-int(((batteryVoltageGraph[k]-minimumGraphValue)/(maximumGraphValue-minimumGraphValue))*maxGraphHeight)+1,SSD1306_WHITE); // draw pixel

  // Add the battery percentage to the battery graphic, move it up/down and invert the colour depending on the battery level
  display.setTextSize(1);
  if (percentage > 60) {
    display.setCursor(99, 30);
    display.setTextColor(SSD1306_BLACK);
  } else if (percentage > 40) {
    display.setCursor(99, 45);
    display.setTextColor(SSD1306_BLACK);
  } else {
    display.setCursor(99, 30);
    display.setTextColor(SSD1306_WHITE);
  }
  display.println((String(int(percentage)) + "%"));

  // Update the display
  display.display();
}

void displayLogo() {
    // Logo - Converted with https://javl.github.io/image2cpp/
    static const unsigned char logo [] PROGMEM = {
    0x00, 0x00, 0x00, 0x00, 0x00, 0x00, 0x00, 0x00, 0x00, 0x00, 0x00, 0x00, 0x00, 0x00, 0x00, 0x00,
      0x00, 0x00, 0x00, 0x00, 0x00, 0x00, 0x00, 0x00, 0x00, 0x00, 0x00, 0x00, 0x00, 0x00, 0x00, 0x00,
      0x00, 0x00, 0x0f, 0xff, 0xff, 0xf8, 0x00, 0x00, 0x00, 0x00, 0x00, 0x00, 0x00, 0x00, 0x00, 0x00,
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      0x00, 0x00, 0x00, 0x00, 0x00, 0x00, 0x00, 0x00, 0x00, 0x00, 0x00, 0x00, 0x00, 0x00, 0x00, 0x00
      };

      display.clearDisplay();
      display.drawBitmap(0, 0, logo, 128, 64, WHITE);
      display.display(); // This has to be called to write the buffer to the display
}
